#include <behaviors.dtsi>
#include <dt-bindings/zmk/keys.h>
#include <dt-bindings/zmk/bt.h>
#include <dt-bindings/zmk/matrix_transform.h> 

/{




    keymap{



        default_layer {
                bindings = <
                    &kp A    &kp B    
                    &kp C    &mo 1    
                   
                >;
            };

            /* Layer 1: Test Layer
            * -------------------
            * | BT_CLR | (trans) |
            * -------------------
            * | (trans)  | (trans) |
            * -------------------
            */
            layer_1 {
                bindings = <
                    &bt BT_CLR   &trans     
                    &trans       &trans    
                    
                >;
            };
    };
};